## boards/custom_mcxn236/board.yml
```yaml
board:
  name: custom_mcxn236
  full_name: Custom MCXN236
  vendor: nxp
  socs:
  - name: mcxn236
```

## boards/scratch_mcxn236/Kconfig.scratch_mcxn236
```kconfig
config BOARD_SCRATCH_MCXN236
	select SOC_MCXN236
	select SOC_PART_NUMBER_MCXN236VDF
```

## boards/scratch_mcxn236/board.yml
```yaml
board:
  name: scratch_mcxn236
  full_name: Scratch MCXN236
  vendor: nxp
  socs:
    - name: mcxn236
```

## modules/led_sensor/drivers/led_sensor/Kconfig
```kconfig
menuconfig LED_SENSOR
	bool "LED sensor driver"
	default y
	depends on DT_HAS_BRUNO_LED_SENSOR_ENABLED
	select GPIO
	select SENSOR
	help
	  Driver that exposes an on-board LED through the sensor API.
```

## modules/led_sensor/dts/bindings/driver/bruno,led-sensor.yaml
```yaml
description: On-board LED exposed as a sensor

compatible: "bruno,led-sensor"

properties:
  gpios:
    type: phandle-array
    required: true
```
